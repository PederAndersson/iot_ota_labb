## components/ota_update/Kconfig.projbuild
```kconfig
menu "OTA lab"

    config APP_OTA_URL
        string "Firmware URL override (HTTP)"
        default ""
        help
            Leave empty to find the lab server automatically by UDP broadcast.
            An explicit URL such as http://192.168.1.10:8000/OTA_labb_code.bin
            can be used if the network blocks broadcast discovery.

    config APP_OTA_POLL_INTERVAL_SECONDS
        int "Check interval (seconds)"
        range 10 3600
        default 60
        help
            How often to check the server for a new firmware image.

endmenu
```

## components/wifi_connect/Kconfig.projbuild
```kconfig
menu "Wi-Fi connection"

    config APP_WIFI_SSID
        string "Wi-Fi SSID"
        default ""

    config APP_WIFI_PASSWORD
        string "Wi-Fi password"
        default ""

endmenu
```

## sdkconfig.defaults
```kconfig
CONFIG_IDF_TARGET="esp32c6"
CONFIG_ESPTOOLPY_FLASHSIZE="4MB"
CONFIG_PARTITION_TABLE_TWO_OTA=y
CONFIG_ESP_HTTPS_OTA_ALLOW_HTTP=y
CONFIG_ESP_MAIN_TASK_STACK_SIZE=8192
CONFIG_COMPILER_OPTIMIZATION_SIZE=y
```
